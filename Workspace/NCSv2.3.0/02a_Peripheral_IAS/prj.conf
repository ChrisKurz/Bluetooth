## CMakeLists.txt
```
# SPDX-License-Identifier: Apache-2.0

cmake_minimum_required(VERSION 3.20.0)

find_package(Zephyr REQUIRED HINTS $ENV{ZEPHYR_BASE})
project(MyPeripheralIAS)

target_sources(app PRIVATE src/main.c)
```

## prj.conf
```kconfig
#=== Enable Bluetooth Stack
CONFIG_BT=y
CONFIG_BT_DEVICE_NAME="IAS peripheral"

#------ Define Bluetooth LE Role 
#CONFIG_BT_BROADCASTER=y   # note: BROADCASTER is activated by default
#CONFIG_BT_CENTRAL=n       not used in this example (default value: n)
#CONFIG_BT_OBSERVER=n      not used in this example (default value: n)
CONFIG_BT_PERIPHERAL=y

#------ Device Information Service (DIS)
CONFIG_BT_DIS=y
CONFIG_BT_DIS_MANUF="Zephyr"
CONFIG_BT_DIS_MODEL="Zephyr Model"
CONFIG_BT_DIS_SERIAL_NUMBER=y
CONFIG_BT_DIS_SERIAL_NUMBER_STR="Zephyr Serial"
CONFIG_BT_DIS_HW_REV=y
CONFIG_BT_DIS_HW_REV_STR="Zephyr Hardware"
CONFIG_BT_DIS_FW_REV=y
CONFIG_BT_DIS_FW_REV_STR="Zephyr Firmware"
CONFIG_BT_DIS_SW_REV=y
CONFIG_BT_DIS_SW_REV_STR="Zephyr Software"
CONFIG_BT_DIS_PNP=n
#CONFIG_BT_DIS_PNP_PID=0x00   not used in this example
#CONFIG_BT_DIS_PNP_VID=0x00   not used in this example
#CONFIG_BT_DIS_PNP_VID_SRC=1  not used in this example
#CONFIG_BT_DIS_PNP_VER=0x01   not used in this example

#------ Immediate Alert Service (IAS)
CONFIG_BT_IAS=y
```

## src/main.c
```c
#include <zephyr/bluetooth/bluetooth.h>
#include <zephyr/bluetooth/conn.h> 
#include <zephyr/bluetooth/uuid.h>

#include <zephyr/bluetooth/services/dis.h>
#include <zephyr/bluetooth/services/ias.h>


static const struct bt_data ad[] = {
    BT_DATA_BYTES(BT_DATA_FLAGS, (BT_LE_AD_GENERAL | BT_LE_AD_NO_BREDR)),
    BT_DATA_BYTES(BT_DATA_UUID16_ALL, BT_UUID_16_ENCODE(BT_UUID_DIS_VAL)),
};

void start_advertising(void)
{
    int err;

    err = bt_le_adv_start(BT_LE_ADV_CONN_NAME, ad, ARRAY_SIZE(ad), NULL, 0);
    if (err) {
        printk("Advertising failed to start (err %d)\n", err);
    }
    else {
        printk("Advertising successfully started\n");
    }
}

static void connected(struct bt_conn *conn, uint8_t err)
{
    if (err) {
         printk("Connection failed (err 0x%02x)\n", err);
    } else {
         printk("Connected\n");
    }
}

/* We remove disconnect handling here, because it is used in IAS Serivce library */
//static void disconnected(struct bt_conn *conn, uint8_t reason)
//{
//    printk("Disconnected (reason 0x%02x)\n", reason);
//    start_advertising();    
//}

static struct bt_conn_cb conn_callbacks = {
    .connected = connected,
//    .disconnected = disconnected,
};

void ias_no_alert(void)
{
    printk("IAS: Stop Alert\n");
}

void ias_mild_alert(void)
{
    printk("IAS: Mild Alert\n");
}

void ias_high_alert(void)
{
    printk("IAS: High Alter\n");
}

BT_IAS_CB_DEFINE(ias_callbacks)={
    .no_alert=   ias_no_alert,
    .mild_alert= ias_mild_alert,
    .high_alert= ias_high_alert,
};

void main (void) {
    printk("Starting MyPeripheral application!\n");

    bt_conn_cb_register(&conn_callbacks);

    int err;

    /* Initialize the Bluetooth Subsystem */
    err = bt_enable(NULL);
    if (err) {
        printk("Bluetooth init failed (err %d)\n", err);
        return;
    }
    printk("Bluetooth initialized\n");

    start_advertising();

}
```
